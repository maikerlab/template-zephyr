## CMakeLists.txt
```
cmake_minimum_required(VERSION 3.20.0)

# Zephyr must be found before project() -- it sets up the toolchain.
find_package(Zephyr REQUIRED HINTS $ENV{ZEPHYR_BASE})
project(maikerlab_zephyr_template)

# Public headers (hal_iface.h)
target_include_directories(app PRIVATE ${CMAKE_CURRENT_SOURCE_DIR}/include)

# Application sources -- add new .c files here.
target_sources(app PRIVATE
    src/main.c
    src/hal.c
)
```

## west.yml
```
# West manifest -- pins the nRF Connect SDK version.
# To switch SDK version, change the revision below and run:
#   west update
# For vanilla Zephyr (without NCS), replace the remote and project with:
#   url-base: https://github.com/zephyrproject-rtos
#   name: zephyr  /  revision: v4.1.0  (or desired tag)
manifest:
  remotes:
    - name: ncs
      url-base: https://github.com/nrfconnect

  projects:
    - name: nrf
      remote: ncs
      repo-path: sdk-nrf
      revision: v3.2.3
      import: true
```

## prj.conf
```kconfig
# Logging subsystem
CONFIG_LOG=y

# GPIO drivers (required for LEDs and buttons)
CONFIG_GPIO=y

# Runtime assertions -- catch bugs early during development
CONFIG_ASSERT=y
```

## boards/nrf7002dk_nrf5340_cpuapp.conf
```kconfig
# Board-specific Kconfig overrides for the nRF7002 DK.
# Symbols set here override prj.conf for this board only.
#
# Example:
#   CONFIG_SERIAL=y
#   CONFIG_UART_CONSOLE=y
```

## boards/nrf7002dk_nrf5340_cpuapp.overlay
```dts
/*
 * Board-specific devicetree overlay for the nRF7002 DK.
 * Use this file to override or extend the base devicetree.
 *
 * Example -- enable an I2C peripheral:
 *
 *   &i2c1 {
 *       status = "okay";
 *       my_sensor: my_sensor@48 {
 *           compatible = "vendor,my-sensor";
 *           reg = <0x48>;
 *       };
 *   };
 */
```

## src/main.c
```c
/**
 * @file main.c
 * @brief Application entry point
 *
 * Demonstrates the HAL abstraction pattern: initializes hardware via hw_init(),
 * registers a button callback that toggles an LED on press, then idles forever.
 */

#include <zephyr/kernel.h>
#include <zephyr/logging/log.h>
#include "hal.h"

LOG_MODULE_REGISTER(main, LOG_LEVEL_DBG);

static const hal_iface_t *hw;

static void on_btn_pressed(btn_id_t btn)
{
	LOG_INF("Button %d pressed", btn);
	hw->led_toggle(LED_1);
}

int main(void)
{
	LOG_INF("Hello, World!");

	hw = hw_init();
	if (hw == NULL) {
		LOG_ERR("Hardware initialization failed");
		return -1;
	}

	if (hw->btn_register_cb(BTN_1, on_btn_pressed) < 0) {
		LOG_ERR("Failed to register button callback");
		return -1;
	}

	/* Keep the main thread alive so ISR-driven callbacks continue to work */
	k_sleep(K_FOREVER);
	return 0;
}
```

## include/hal_iface.h
```c
/**
 * @file hal_iface.h
 * @brief Public Hardware Abstraction Layer interface
 *
 * Defines the HAL as a struct of function pointers. Production code fills
 * these with real Zephyr drivers (see hal.c); tests inject mocks (see
 * tests/unit/mock_hal.h). Application code only depends on this header,
 * keeping it decoupled from hardware specifics.
 *
 * All HAL functions return 0 on success, negative errno on failure.
 */

#pragma once

/** LED identifiers. */
typedef enum {
	LED_1,
	/* TODO: Define additional LEDs here */

	/** Sentinel -- keep last. Equals the number of LEDs defined above. */
	LED_COUNT,
} led_id_t;

/** Button identifiers. */
typedef enum {
	BTN_1,
	/* TODO: Define additional buttons here */

	/** Sentinel -- keep last. Equals the number of buttons defined above. */
	BTN_COUNT,
} btn_id_t;

/** Callback invoked by the HAL when a button is pressed. */
typedef void (*btn_callback_t)(btn_id_t btn);

/**
 * Abstract hardware interface.
 * In production code filled with real drivers, in tests with mocks.
 */
typedef struct {
	/** Toggle the state of the specified LED. */
	int (*led_toggle)(led_id_t led);

	/** Register a callback for button press events. */
	int (*btn_register_cb)(btn_id_t btn, btn_callback_t cb);

	/* TODO: Add additional hardware interface functions here */
} hal_iface_t;
```

## src/hal.c
```c
/**
 * @file hal.c
 * @brief HAL implementation using Zephyr GPIO drivers
 *
 * Maps the abstract hal_iface_t to real hardware via devicetree aliases
 * (led0, sw0). Manages LED output, button input with edge-triggered
 * interrupts, and callback dispatch.
 */

#include <zephyr/drivers/gpio.h>
#include <zephyr/logging/log.h>
#include "hal.h"

LOG_MODULE_REGISTER(hal, LOG_LEVEL_DBG);

/* GPIO specs obtained from devicetree aliases, indexed by led/btn ID */
static const struct gpio_dt_spec leds[] = {
	[LED_1] = GPIO_DT_SPEC_GET(DT_ALIAS(led0), gpios),
};

static const struct gpio_dt_spec btns[] = {
	[BTN_1] = GPIO_DT_SPEC_GET(DT_ALIAS(sw0), gpios),
};

/* Per-button callback storage and GPIO callback structs */
static btn_callback_t btn_callbacks[BTN_COUNT];
static struct gpio_callback btn_cb_data[BTN_COUNT];

/**
 * @brief GPIO ISR for button presses.
 *
 * Checks each button's pin against the triggered pin mask and dispatches
 * the registered callback, if any.
 */
static void gpio_btn_isr(const struct device *dev, struct gpio_callback *cb, uint32_t pins)
{
	for (int i = 0; i < BTN_COUNT; i++) {
		if ((pins & BIT(btns[i].pin)) && btn_callbacks[i]) {
			btn_callbacks[i]((btn_id_t)i);
		}
	}
}

static int hw_led_toggle(led_id_t led)
{
	if (led >= LED_COUNT) {
		return -EINVAL;
	}
	return gpio_pin_toggle_dt(&leds[led]);
}

static int hw_btn_register_cb(btn_id_t btn, btn_callback_t cb)
{
	if (btn >= BTN_COUNT) {
		return -EINVAL;
	}
	btn_callbacks[btn] = cb;
	return 0;
}

static const hal_iface_t iface = {
	.led_toggle = hw_led_toggle,
	.btn_register_cb = hw_btn_register_cb,
};

const hal_iface_t *hw_init(void)
{
	for (int i = 0; i < LED_COUNT; i++) {
		if (!gpio_is_ready_dt(&leds[i])) {
			LOG_ERR("LED %d GPIO not ready", i);
			return NULL;
		}
		if (gpio_pin_configure_dt(&leds[i], GPIO_OUTPUT_INACTIVE) < 0) {
			LOG_ERR("Failed to configure LED %d", i);
			return NULL;
		}
	}

	for (int i = 0; i < BTN_COUNT; i++) {
		if (!gpio_is_ready_dt(&btns[i])) {
			LOG_ERR("Button %d GPIO not ready", i);
			return NULL;
		}
		if (gpio_pin_configure_dt(&btns[i], GPIO_INPUT) < 0) {
			LOG_ERR("Failed to configure button %d", i);
			return NULL;
		}
		if (gpio_pin_interrupt_configure_dt(&btns[i], GPIO_INT_EDGE_TO_ACTIVE) < 0) {
			LOG_ERR("Failed to configure button %d interrupt", i);
			return NULL;
		}
		gpio_init_callback(&btn_cb_data[i], gpio_btn_isr, BIT(btns[i].pin));
		if (gpio_add_callback(btns[i].port, &btn_cb_data[i]) < 0) {
			LOG_ERR("Failed to add button %d callback", i);
			return NULL;
		}
	}

	LOG_INF("Hardware initialized");
	return &iface;
}
```

## src/hal.h
```c
/**
 * @file hal.h
 * @brief Private hardware initialisation header
 *
 * Declares hw_init(), which configures GPIOs and returns the production
 * HAL interface. This header is private to src/ -- tests never include it.
 */

#pragma once

#include "hal_iface.h"

/**
 * @brief Initialise hardware and return the HAL interface.
 *
 * Configures GPIO for LEDs (output) and buttons (input with edge interrupt).
 * Must be called once during application startup.
 *
 * @return Pointer to a static hal_iface_t on success, or NULL if any GPIO
 *         initialisation step fails (errors are logged via LOG_ERR).
 */
const hal_iface_t *hw_init(void);
```
