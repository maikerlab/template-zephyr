## tests/unit/testcase.yaml
```yaml
# Twister test metadata
# Run with: west twister -T tests/unit -p native_sim
tests:
  app.smoke_test:
    platform_allow:
      - native_sim
      - nrf7002dk/nrf5340/cpuapp
    tags: smoke_test
    harness: ztest
    timeout: 30
```
